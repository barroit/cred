## Kconfig
```kconfig
# SPDX-License-Identifier: GPL-3.0-or-later

source "lib/Kconfig.include"

mainmenu "$(pg-name)/$(pg-build)-$(pg-arch) $(pg-version) Configuration"

source "lib/Kconfig.build"

source "lib/Kconfig.feature"

source "lib/Kconfig.sqlite"

source "lib/Kconfig.debug"
```

## lib/Kconfig.build
```kconfig
# SPDX-License-Identifier: GPL-3.0-or-later

menu "Build options"

choice
	prompt "Compiler optimization level"
	default CC_OPTIMIZE_NONE if ENABLE_DEBUG
	default CC_OPTIMIZE_PERF

config CC_OPTIMIZE_NONE
	bool "Disable optimization (-O0)"

config CC_OPTIMIZE_PERF
	bool "Optimize for performance (-O2)"

config CC_OPTIMIZE_O3
	bool "Further optimizing performance (-O3)"

endchoice

config ENABLE_ARCH_SPEC
	bool "Add arch-specific code"
	depends on $(exist,arch/.map)

config ENABLE_GUI
	bool "Build program with gui"
	depends on $(WIN32)

config ENABLE_WCHAR
	bool "Use wide character"
	default y
	depends on $(WIN32)

menu "Memory allocation"

config PANIC_NOMEM
	bool "Abort execution when memory allocation fails"
	default ENABLE_DEBUG
	help
	  This is unlikely to happen on modern systems, as running out
	  of memory is rare in most cases.

config WARN_HUGE_ALLOC
	bool "Warn when allocating a large amount of memory"
	default PANIC_NOMEM
	depends on PANIC_NOMEM

endmenu # Memory allocation

config ENABLE_TEST
	bool "Generate test suite"

config IGNORE_ANNOT_LEAKS
	bool "Suppress annotated leaks"

config EXEC_NAME
	string "Executable name"
	default $(lower,$(pg-name))

endmenu # Executable build options
```

## lib/Kconfig.sqlite
```kconfig
# SPDX-License-Identifier: GPL-3.0-or-later

menu "SQLite tuning"

config SQLITE_SOURCE_ID_OFFSET
	int "Source ID hash offset"
	default 20

endmenu # Sqlite tuning
```
